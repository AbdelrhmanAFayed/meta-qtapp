## meta-myqt6/conf/layer.conf
```bitbake
# We have a conf and classes directory, add to BBPATH
BBPATH .= ":${LAYERDIR}"

# We have recipes-* directories, add to BBFILES
BBFILES += "${LAYERDIR}/recipes-*/*/*.bb \
            ${LAYERDIR}/recipes-*/*/*.bbappend"

BBFILE_COLLECTIONS += "meta-myqt6"
BBFILE_PATTERN_meta-myqt6 = "^${LAYERDIR}/"
BBFILE_PRIORITY_meta-myqt6 = "6"

LAYERDEPENDS_meta-myqt6 = "meta-qt6 meta-python"


LAYERDEPENDS_meta-myqt6 = "core"
LAYERSERIES_COMPAT_meta-myqt6 = "kirkstone"

PACKAGECONFIG:append:pn-weston = " rdp" 

FILESEXTRAPATHS:prepend := "${THISDIR}/recipes-qt/myqt/files:"

DISTRO_FEATURES:append = " systemd pam"
VIRTUAL-RUNTIME_init_manager = "systemd"
```
